## sdkconfig.defaults
```kconfig
#
# MI-RC003-ESP32-Bridge - default configuration (ESP32-S3, 16MB flash / 8MB PSRAM)
#

# ---- Target ---------------------------------------------------------------
CONFIG_IDF_TARGET="esp32s3"

# ---- Flash / PSRAM --------------------------------------------------------
CONFIG_ESPTOOLPY_FLASHSIZE_16MB=y
CONFIG_ESPTOOLPY_FLASHMODE_QIO=y
CONFIG_ESPTOOLPY_FLASHFREQ_80M=y
CONFIG_SPIRAM=y
CONFIG_SPIRAM_MODE_OCT=y
CONFIG_SPIRAM_SPEED_80M=y
CONFIG_SPIRAM_TRY_ALLOCATE_WIFI_LWIP=n

# ---- Partition table ------------------------------------------------------
CONFIG_PARTITION_TABLE_CUSTOM=y
CONFIG_PARTITION_TABLE_CUSTOM_FILENAME="partitions.csv"

# ---- FreeRTOS -------------------------------------------------------------
CONFIG_FREERTOS_HZ=1000
CONFIG_ESP_MAIN_TASK_STACK_SIZE=8192

# ---- Bluetooth / NimBLE ---------------------------------------------------
CONFIG_BT_ENABLED=y
CONFIG_BT_NIMBLE_ENABLED=y
CONFIG_BT_NIMBLE_ROLE_CENTRAL=y
CONFIG_BT_NIMBLE_ROLE_OBSERVER=y
CONFIG_BT_NIMBLE_ROLE_PERIPHERAL=n
CONFIG_BT_NIMBLE_ROLE_BROADCASTER=n
CONFIG_BT_NIMBLE_MAX_CONNECTIONS=1
CONFIG_BT_NIMBLE_ATT_PREFERRED_MTU=512
CONFIG_BT_NIMBLE_L2CAP_COC_MAX_NUM=0
CONFIG_BT_NIMBLE_SM_LEGACY=y
CONFIG_BT_NIMBLE_SM_SC=y
CONFIG_BT_NIMBLE_NVS_PERSIST=y
CONFIG_BT_NIMBLE_HOST_TASK_STACK_SIZE=5120
CONFIG_BT_NIMBLE_HS_FLOW_CTRL=y
CONFIG_BT_NIMBLE_HS_FLOW_CTRL_ITVL=1000
CONFIG_BT_NIMBLE_HS_FLOW_CTRL_THRESH=2

# ---- TinyUSB composite device --------------------------------------------
# 1 HID interface (keyboard/consumer/mouse). The gamepad is a custom XUSB
# (XInput) class driver, not a HID instance.
CONFIG_TINYUSB_HID_COUNT=1
CONFIG_TINYUSB_CDC_ENABLED=n
CONFIG_TINYUSB_VENDOR_COUNT=1
CONFIG_TINYUSB_VENDOR_RX_BUFSIZE=4096
CONFIG_TINYUSB_VENDOR_TX_BUFSIZE=16384
CONFIG_TINYUSB_VENDOR_EPSIZE=64
CONFIG_TINYUSB_DESC_MANUFACTURER_STRING="MI-RC003"
CONFIG_TINYUSB_DESC_PRODUCT_STRING="MI-RC003 Remote Bridge"
CONFIG_TINYUSB_SUSPEND_CALLBACK=y
CONFIG_TINYUSB_RESUME_CALLBACK=y

# ---- Logging --------------------------------------------------------------
CONFIG_LOG_DEFAULT_LEVEL_INFO=y
```

## sdkconfig.defaults.n4r2
```kconfig
# MI-RC003 Bridge - ESP32-S3-WROOM-1 N4R2
CONFIG_IDF_TARGET="esp32s3"
CONFIG_ESPTOOLPY_FLASHSIZE_4MB=y
CONFIG_ESPTOOLPY_FLASHMODE_QIO=y
CONFIG_ESPTOOLPY_FLASHFREQ_80M=y
CONFIG_SPIRAM=y
CONFIG_SPIRAM_MODE_QUAD=y
CONFIG_SPIRAM_SPEED_80M=y
CONFIG_SPIRAM_TRY_ALLOCATE_WIFI_LWIP=n
CONFIG_PARTITION_TABLE_CUSTOM=y
CONFIG_PARTITION_TABLE_CUSTOM_FILENAME="partitions_4mb.csv"
```
